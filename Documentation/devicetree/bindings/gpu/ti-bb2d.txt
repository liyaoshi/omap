## Documentation/devicetree/bindings/gpu/ti-bb2d.txt
```
* Texas Instruments BB2D blitter module

BB2D is a 2D blitter module available in Texas Instruments SoC's to
accelerate 2D blitting operations. This binding describes the BB2D
module integration to the device tree framework.

Require properties:
  - compatible: value should take the following format:
        "ti,<soc>-bb2d"

  - reg : base address and length of BB2D IP registers
  - interrupts : BB2D interrupt line number
  - ti,hwmods : name of the hwmod associated with BB2D module
  - clocks : form SoC clock binding: handle to module clocks

Optional properties:
  - reg-names : names of registers listed in reg property in same order
  - clock-names : names of clocks listed in clocks property in same order

Example for DRA7x SoC:
        bb2d: bb2d@59000000 {
            compatible = "ti,dra7-bb2d";
            reg = <0x59000000 0x0700>;
            interrupts = <GIC_SPI 120 IRQ_TYPE_LEVEL_HIGH>;
            ti,hwmods = "bb2d";
            clocks = <&dpll_core_h24x2_ck>;
            clock-names = "fck";
        };
```

## Documentation/devicetree/bindings/hwlock/hwspinlock-user.txt
```
Hardware spinlock user-space interface
======================================

A hwspinlock client that provides ioctls to lock and unlock the
reserved hwlocks.

Required properties:
- compatible:		Should be "hwspinlock-user"
- hwlocks:		An array of the phandle and hwlock number
			specifier tuple

Example:

gatemp {
	compatible = "hwspinlock-user";
	hwlocks = <&hwspinlock 0>,
		  <&hwspinlock 1>,
		  <&hwspinlock 2>,
		  <&hwspinlock 3>;
};
```
